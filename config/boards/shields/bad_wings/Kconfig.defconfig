## config/boards/shields/bad_wings/Kconfig.defconfig
```kconfig
# Copyright (c) 2022 The ZMK Contributors
# SPDX-License-Identifier: MIT

if SHIELD_BAD_WINGS_DONGLE || SHIELD_BAD_WINGS

config ZMK_KEYBOARD_NAME
    default "Bad Wings"

endif

if SHIELD_BAD_WINGS_DONGLE
config ZMK_SPLIT_ROLE_CENTRAL
    default y
endif

if SHIELD_BAD_WINGS_DONGLE || SHIELD_BAD_WINGS_BODY
config ZMK_SPLIT
    default y
endif
```

## config/boards/shields/bad_wings/Kconfig.shield
```kconfig
# Copyright (c) 2022 The ZMK Contributors
# SPDX-License-Identifier: MIT

config SHIELD_BAD_WINGS
    def_bool $(shields_list_contains,bad_wings)
    select SPI

config SHIELD_BAD_WINGS_DONGLE
    def_bool $(shields_list_contains,bad_wings_dongle)

config SHIELD_BAD_WINGS_BODY
    def_bool $(shields_list_contains,bad_wings_body)
    select SPI
```

## config/boards/shields/bad_wings_go/Kconfig.defconfig
```kconfig
# Copyright (c) 2022 The ZMK Contributors
# SPDX-License-Identifier: MIT

if SHIELD_BAD_WINGS_GO

config ZMK_KEYBOARD_NAME
    default "Bad Wings: Go"
endif
```

## config/boards/shields/bad_wings_go/Kconfig.shield
```kconfig
# Copyright (c) 2022 The ZMK Contributors
# SPDX-License-Identifier: MIT

config SHIELD_BAD_WINGS_GO
    def_bool $(shields_list_contains,bad_wings_go)
```

## config/west.yml
```yaml
manifest:
  remotes:
    - name: zmkfirmware
      url-base: https://github.com/zmkfirmware
    - name: crides
      url-base: https://github.com/crides/zmk

  projects:
    - name: zmk
      remote: crides
      revision: cirque-trackpad
      import: app/west.yml
  self:
    path: config
```
