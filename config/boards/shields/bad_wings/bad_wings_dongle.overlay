/*
 * Copyright (c) 2022 The ZMK Contributors
 *
 * SPDX-License-Identifier: MIT
 */

#include "bad_wings.dtsi"
/ {
	

	kscan0: kscan {
		compatible = "zmk,kscan-gpio-direct";
		label = "KSCAN";
    input-gpios = <&gpio0 15 (GPIO_ACTIVE_LOW | GPIO_PULL_UP)>;
	};
};